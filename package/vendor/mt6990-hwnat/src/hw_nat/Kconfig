## package/vendor/mt6990-hwnat/src/hw_nat/Kconfig
```kconfig
config RA_HW_NAT
        tristate "Ralink HW NAT(** Work At Module Mode ONLY **)"
	depends on RA_NAT_HW
	---help---
	  This driver supports Mediatek HW NAT.

	  Note that the answer to this question doesn't directly affect the
	  kernel: saying N will just cause the configurator to skip all
	  the questions about Mediatek Ethernet devices. If you say Y,
	  you will be asked for your specific card in the following questions.

config  RA_HW_NAT_BINDING_THRESHOLD
        int "Binding Threshold (Unit:Packet Per Second)"
	depends on RA_HW_NAT
	default 30
	help
	When flow rate > Binding Threshold  (# Packets Per Second),
	the state will change to bind state

choice
        prompt "Foe Table Size"
	depends on RA_HW_NAT
	default RA_HW_NAT_TBL_4K
	help
	Number of entries in FoE Table

config  RA_HW_NAT_TBL_1K
        bool "1K"
	depends on RA_HW_NAT

config  RA_HW_NAT_TBL_2K
        bool "2K"
	depends on RA_HW_NAT

config  RA_HW_NAT_TBL_4K
        bool "4K"
	depends on RA_HW_NAT

config  RA_HW_NAT_TBL_8K
        bool "8K"
	depends on RA_HW_NAT

config  RA_HW_NAT_TBL_16K
        bool "16K"
	depends on RA_HW_NAT

config  RA_HW_NAT_TBL_32K
        bool "32K"
	depends on RA_HW_NAT
endchoice

choice
	prompt "Hash Algorithm"
	depends on RA_HW_NAT
	default RA_HW_NAT_HASH1

config  RA_HW_NAT_HASH0
        bool "Hash0-Simple"
	depends on RA_HW_NAT

config  RA_HW_NAT_HASH1
        bool "Hash1-Complex"
	depends on RA_HW_NAT

config  RA_HW_NAT_HASH2
        bool "Hash2-Complex"
	depends on RA_HW_NAT

config  RA_HW_NAT_HASH3
        bool "Hash3-Complex"
	depends on RA_HW_NAT

config  RA_HW_NAT_HASH_DBG
        bool "Hash-Debug"
	depends on RA_HW_NAT

endchoice

choice
        prompt "HW_NAT OP MODE"
	depends on RA_HW_NAT && (RA_HW_NAT_HASH1 || RA_HW_NAT_HASH2)
	default HW_NAT_AUTO_MODE
	help
	Say Y here if you want to enable HWNAT Operation mode on
	MT762x series SoCs. There is three type operation mode you can choose.

config  HW_NAT_AUTO_MODE
        bool "AUTO_MODE"
	help
	Say Y here if you want to enable HWNAT Operation auto mode
	on MT762x series SoCs.
	There is hwnat auto learn mode, driver fill ppetable,
	and set entry bind.

config  HW_NAT_SEMI_AUTO_MODE
        bool "SEMI_AUTO_MODE"
	help
	Say Y here if you want to enable HWNAT Operation auto mode on
	MT762x series SoCs.
	There is hwnat semi-auto learn mode, driver fill ppetable,
	but user set entry bind.

config  HW_NAT_MANUAL_MODE
        bool "MANUAL_MODE"
	help
	Say Y here if you want to enable HWNAT Operation auto mode on
	MT762x series SoCs.
	There is hwnat manual mode, user fill ppetable,
	but user set entry bind.

endchoice

choice
	prompt "Hash DBG Mode"
	depends on RA_HW_NAT_HASH_DBG
	default RA_HW_NAT_HASH_DBG_SPORT

config  RA_HW_NAT_HASH_DBG_IPV6_SIP
        bool "IPv6 source IP[15:0]"

config  RA_HW_NAT_HASH_DBG_IPV4_SIP
        bool "IPv4 source IP[15:0]"

config  RA_HW_NAT_HASH_DBG_SPORT
        bool "source port[15:0]"

endchoice

config  RA_HW_NAT_IPV6
        bool "IPv6 Acceleration"
	depends on RA_HW_NAT
	default y
	help
	"ipv6 routing accelerated by HNAT"

config  PPE_MCAST
        bool "PPE built-in multicast table support"
	depends on RA_HW_NAT

config  RA_HW_NAT_WIFI
	bool "WiFi Acceleration"
	depends on RA_HW_NAT
	select RA_HW_NAT_WIFI_NEW_ARCH

config  RA_HW_NAT_WIFI_NEW_ARCH
	bool "WiFi Fast Path(WHNAT)"
	depends on RA_HW_NAT_WIFI

config  SUPPORT_WLAN_OPTIMIZE
	bool "Wlan <-> Lan Go SW Path"
	depends on RA_HW_NAT_WIFI
	help
	Say Y here if you want to enable wlan to lan will go sw path
	on MT762x series SoCs.
	Because bridge traffic has no benefit when hwnat accelerate.
	We will judgment wlan and br0 has the same subnet or not.

config WAN_TO_WLAN_SUPPORT_QOS
	bool "Wan ->Wlan Support QoS"
	depends on RA_HW_NAT_WIFI
	default n
	help
	Say Y here if you want to enable HWNAT support qos on
	MT762x series SoCs.
	HWNAT lan <-> wan will go to qdma schedule.
	If yoy say Y, short packet cannot wire speed.

config ARCH_MT7622_WIFI_HW_NAT
	bool "Warp Drive HW NAT"
	depends on RA_HW_NAT_WIFI
	help
	Say Y here if you want to enable Warp Drive HW NAT
	on MT762x series SoCs.
	ethernet to wlan will go WHNAT
	If yoy say Y, ethernet to wlan cpu loading almost equal zero.

config  RA_HW_NAT_PACKET_SAMPLING
	bool "Packet Sampling to CPU"
	depends on RA_HW_NAT && (MACH_MT7623 || MTK_EMI_7622)

config RA_HW_NAT_ACCNT_MAINTAINER
	bool "Get Statistic Counter Periodically(Accounting Group)"
	depends on RA_HW_NAT
	help
	"if you need 64bits bytes/pkts counter, and ask HNAT module to get statistic counter periodically, please enable it"

config PPE_MIB
	bool "Per Flow Mib Counter"
	depends on RA_HW_NAT
	help
	"if you need bytes/pkts counter per flow entry, and ask HNAT module to get statistic counter periodically, please enable it"

config QDMA_SUPPORT_QOS
	bool "Wired Ethernet Support QoS"
	depends on RA_HW_NAT
	default y
	help
	Say Y here if you want to enable HWNAT support qos on
	MT762x series SoCs.
	HWNAT lan <-> wan will go to qdma schedule.
	If yoy say Y, short packet cannot wire speed.

config HW_NAT_SW_DVFS
	bool "S/W (Timer) Based DVFS"
	depends on RA_HW_NAT
	default y
	help
	Say Y here if would like to enable SW Based DVFS feature.

config HW_NAT_SW_DVFS_DEFAULT_OPP
	int "S/W DVFS Default OPP"
	depends on HW_NAT_SW_DVFS
	range 0 3
	default 3
	help
	Say Y here if would like to enable SW Based DVFS feature
```

## target/linux/mediatek/files-6.18/drivers/misc/mediatek/Kconfig
```kconfig
menu "MediaTek vendor modem drivers"

source "drivers/misc/mediatek/ccci_util/Kconfig"
source "drivers/misc/mediatek/eccci/Kconfig"
source "drivers/misc/mediatek/ccmni/Kconfig"
source "drivers/misc/mediatek/hsapif/Kconfig"
source "drivers/misc/mediatek/medmcu/Kconfig"

endmenu

# LG6851F persistent modem Kconfig
source "drivers/misc/mediatek/Kconfig.lg6851f"
```

## target/linux/mediatek/files-6.18/drivers/misc/mediatek/ccmni/Kconfig
```kconfig
config MTK_NET_CCMNI
	tristate "MediaTek CCMNI driver"
	depends on MTK_CCCI_DEVICES
	help
	  Cross Core Multi Network Interface:
	  This option enables CCMNI driver, if yes,
	  then CCMNI driver is used
	  to communicate with CCCI
	  driver by Kernel network, if no,
	  Kernel network uses ccci port_net
	  to send and recevie data.
	  The option default depends on MTK_CCCI_DEVICES.
config MTK_ETHERNET_PDU
	tristate "Specify CCMNI support Ethernet PDU"
	default n
	help
	  Whether CCMNI MTU is enlarged to fit
	  Ethernet PDU requirement
	  driver by Kernel network, if no,
	  Set Y to enable this feature.
	  If unsure,
	  Set N to stay with legacy feature.
config MTK_WAN_MTU_SIZE
	int "configure WAN MTU size"
	default 1500
	help
	  1500 => default
	  1522 => Ethernet PDU
	  1570 => EoGRE,
	  2000 => Vzw
```

## target/linux/mediatek/files-6.18/drivers/misc/mediatek/eccci/Kconfig
```kconfig
config MTK_ECCCI_DRIVER
	tristate "Enable Evolved CCCI Driver as interface for modem"
	depends on MTK_CCCI_DEVICES
	select MTK_NET_CCMNI
	help
	  This option enables ECCCI device driver support, if yes,
	  then modem1 is using eccci driver, if no,
	  eccci driver is disabled.
	  The option default disabled.

config MTK_ECCCI_CLDMA
	tristate "ECCCI driver using CLDMA HW to communicate with LTE modem"
	depends on MTK_ECCCI_DRIVER
	default y
	help
	  This option enables ECCCI CLDMA driver, if yes,
	  then modem1 is using cldma hardware, if no,
	  cldma hardware is disabled.
	  The option default disabled.

config MTK_ECCCI_CCIF
	tristate "ECCCI driver using CCIF HW to communicate with LTE modem"
	depends on MTK_ECCCI_DRIVER
	help
	  This option enables ECCCI CCIF driver, if yes,
	  then modem1 is using ccif hardware, if no,
	  ccif hardware is disabled,
	  The option default disabled.

config MTK_ECCCI_C2K
	bool "ECCCI driver using CCIF HW to communicate with C2K modem"
	depends on MTK_ECCCI_DRIVER
	help
	  This option enables ECCCI CCIF C2K driver, if yes,
	  c2k modem is enabled, if no,
	  c2k modem is disabled,
	  The option default disabled.

config MTK_SIM_LOCK_POWER_ON_WRITE_PROTECT
	bool "sim lock poweron write protect"
	help
	  To support SIM lock power on write protect  feature, if yes,
	  then it is supported, if no,
	  it is disabled.
	  The option default disabled.

config MTK_ECCCI_DATA_PLANE_TYPE
	int "Data Plane Type of CCCI data path"
	depends on MTK_ECCCI_DRIVER
	default 0
	help
	  Data Plane Type:
	  0=>Modem,
	  1=>DPMAIF

config MTK_ECCCI_DPMAIF_SHRINK_MEM_FEATURE
	tristate "Data Plane DPMAIF shrink feature"
	depends on MTK_ECCCI_DRIVER
	default n
	help
	  Enabled might affect operator test cases
	  Feature Type:
	  n=>not enabled,
	  y=>enabled

if MTK_ECCCI_DATA_PLANE_TYPE=2
config MTK_ECCCI_NO_MDINIT
	tristate "ECCCI driver without ccci_mdinit service"
	depends on MTK_ECCCI_DRIVER
	help
	  This option skip user check for ccci_fsm_ioctl, if yes,
	  then boot up or power down modem internally in kernel, if no,
	  boot up or power down modem by ccci_mdinit.
	  The option default disabled.

config MTK_ECCCI_FLASHLESS
	tristate "ECCCI driver with flashless logic"
	depends on MTK_ECCCI_DRIVER
	depends on MTK_ECCCI_NO_MDINIT
	help
	  This option enables flashless logic in kernel, if yes,
	  then boot up modem internally in kernel, if no,
	  boot up modem by ccci_mdinit.
	  The option default disabled.

endif
```

## target/linux/mediatek/files-6.18/drivers/misc/mediatek/hsapif/Kconfig
```kconfig
config MTK_HSAPIF_DRIVER
	bool "Enable Evolved CLDMA Driver as interface for PCIE"
	default y
	help
	  This option enables CLDMA device driver support,
	  if yes, then PC is using cldma driver,
	  if no, cldma driver is disabled.
	  The option default enable.

config MTK_HSAPIF_DUMP
	bool "CLDMA DUMP support"
	default y
	help
	  This option enables CLDMA device driver dump buffer support,
	  if yes, then cldma driver dump beffer is enabled,
	  if no, cldma driver dump beffer is disabled.
	  The option default enable.

config MTK_HSAPIF_PRI_PORT
	bool "CLDMA Private Port support"
	default y
	help
	  This option enables CLDMA device driver private port support,
	  if yes, then cldma driver private port is enabled,
	  if no, cldma driver private port is disabled.
	  The option default enable.
```

## target/linux/mediatek/files-6.18/drivers/misc/mediatek/medmcu/Kconfig
```kconfig
config MTK_TINYSYS_MEDMCU_SUPPORT
	tristate "Specify Interface Support MEDMCU"
	default n
	help
		MEDMCU is a MediaTek in-house DSP which can receive
		command from IPI interface.
		Set Y to enable this feature.
		If unsure,
		Set N to stay with legacy feature.

config MTK_TINYSYS_MEDMCU_RV33_SUPPORT
	tristate "Specify micro processor RV33 supported by MEDMCU"
	depends on MTK_TINYSYS_MEDMCU_SUPPORT
	default MTK_TINYSYS_MEDMCU_SUPPORT
	help
		RV33 is one uP supported by SCP which designed by RISC-V.
		Set Y to enable this feature.
		If unsure,
		Set N to stay with legacy feature.
```
